## CMakeLists.txt
```
#
# Copyright (c) 2016 Intel Corporation
#
# SPDX-License-Identifier: Apache-2.0
#

cmake_minimum_required(VERSION 3.20.0)
find_package(Zephyr REQUIRED HINTS $ENV{ZEPHYR_BASE})
project(nrf_connect_sdk_fundamentals)

target_sources(app PRIVATE src/main.c)
target_sources(app PRIVATE src/log.c)
target_sources(app PRIVATE src/led.c)
target_sources(app PRIVATE src/button.c)
target_sources(app PRIVATE src/fsm_base.c)
target_sources(app PRIVATE src/fsm.c)
target_sources(app PRIVATE build/zephyr/misc/generated/syscalls_links/include/zephyr/debug/thread_analyzer.h)

target_include_directories(app PRIVATE
    ${CMAKE_CURRENT_SOURCE_DIR}/build/zephyr/misc/generated/syscalls_links/include/zephyr/debug/)
```

## prj.conf
```kconfig
#
# Copyright (c) 2016 Intel Corporation
#
# SPDX-License-Identifier: Apache-2.0
# #
CONFIG_THREAD_ANALYZER=y

CONFIG_THREAD_ANALYZER_USE_PRINTK=y

# CONFIG_THREAD_ANALYZER_AUTO=y
# CONFIG_THREAD_ANALYZER_AUTO_INTERVAL=5


CONFIG_GPIO=y

CONFIG_LOG=y


# CONFIG_THREAD_ANALYZER_AUTO=y
# CONFIG_THREAD_ANALYZER_AUTO_INTERVAL=5
# CONFIG_THREAD_ANALYZER_RUN_UNLOCKED=y

# STEP 3 - Disable colors in the backend
# CONFIG_LOG_BACKEND_SHOW_COLOR=n
# STEP 5 - Enable minimal logging
# CONFIG_LOG_MODE_MINIMAL=y
```

## src/main.c
```c
/*
 * Copyright (c) 2016 Intel Corporation
 *
 * SPDX-License-Identifier: Apache-2.0
 */

#include <zephyr/kernel.h>
#include <thread_analyzer.h>
#include "log.h"
#include "button.h"
#include "fsm.h"
#include "fsm_base.h"
static const Event ev_push = {.sig = PUSH_SIG};
static const Event ev_card = {.sig = CARD_SIG};
LOG_MODULE_DECLARE(log_module);
static Fsm fsm; 

void _button_callback(const short button){
  // Event ev;
  
  switch (button)
  {
  case PUSH_BUTTON:
    // ev.sig = PUSH_SIG;
    fsm_base_add_ev(&fsm.super,&ev_push);
    break;
  case CARD_BUTTON:
    // ev.sig = CARD_SIG;
    fsm_base_add_ev(&fsm.super,&ev_card);
    break;
  default:
    break;
  }
}

void main(void)
{
  LOG_INF("Main started.");
  fsm_ctr(&fsm);

  button_init(_button_callback);
  // thread_analyzer_print();
  
}
```

## src/button.c
```c
#include "button.h"
#include "log.h"


// Define aliases for buttons
#define NUM_BUTTONS 2
#define SW0_NODE DT_ALIAS(sw0)
#define SW1_NODE DT_ALIAS(sw1)
// #define SW2_NODE DT_ALIAS(sw2)
// #define SW3_NODE DT_ALIAS(sw3)
LOG_MODULE_DECLARE(log_module);


static const struct gpio_dt_spec buttons[] = {
    GPIO_DT_SPEC_GET(SW0_NODE, gpios),
    GPIO_DT_SPEC_GET(SW1_NODE, gpios)//,
    // GPIO_DT_SPEC_GET(SW2_NODE, gpios),
    // GPIO_DT_SPEC_GET(SW3_NODE, gpios)
};

static struct gpio_callback callbacks[NUM_BUTTONS];

static ButtonCallback button_callback;

void _button_pressed(const struct device *dev, struct gpio_callback *callback, uint32_t pins){
    if (callback == &callbacks[0]) {
        LOG_INF("Button CARD pressed\n");
        button_callback(CARD_BUTTON); // Notify CARD_BUTTON press
    } else if (callback == &callbacks[1]) {
        button_callback(PUSH_BUTTON); // Notify PUSH_BUTTON press
        LOG_INF("Button PUSH pressed\n");
    }
}


void button_init(ButtonCallback ext_callback){
    int ret;
    LOG_INF("button_init begin.");

    if (!device_is_ready(buttons[0].port)) {
        LOG_ERR("Device is not ready!\n");
        return;
	}
    for (int i = 0; i < NUM_BUTTONS; i++){
        ret = gpio_pin_configure_dt(&buttons[i], GPIO_INPUT);
        if (ret < 0) {
            LOG_ERR("Button  %d GPIO_INPUT is not configured!\n",i);
            return;
        }
	    ret = gpio_pin_interrupt_configure_dt(&buttons[i], GPIO_INT_EDGE_FALLING);
        if (ret < 0) {
            LOG_ERR("Button %d iterrupt is not configured!\n",i);
            return;
        }   
        gpio_init_callback(&callbacks[i], _button_pressed, BIT(buttons[i].pin));
        gpio_add_callback(buttons[i].port, &callbacks[i]);
    }
    button_callback = ext_callback;
    LOG_INF("button_init end.");
}
```

## src/button.h
```c
#ifndef BUTTON_H
#define BUTTON_H

#include <zephyr/kernel.h>
#include <zephyr/device.h>
#include <zephyr/devicetree.h>
#include <zephyr/drivers/gpio.h>



typedef void(*ButtonCallback)(const short button);

typedef const enum{
    CARD_BUTTON,
    PUSH_BUTTON
}button_type;



void button_init(ButtonCallback ext_callback);





#endif
```

## src/fsm.c
```c
#include "fsm.h"
#include "button.h"
#include "led.h"
#include "log.h"
#include <stdio.h>

LOG_MODULE_DECLARE(log_module);

void _fsm_locked(Fsm *this, const Event * const ev);

void _fsm_open(Fsm *this, const Event * const ev){
    LOG_INF("_fsm_open begin.");
    //print
    Signal sig = ev->sig;
    char sig_str[20];
    snprintf(sig_str, sizeof(sig_str), "%d", sig);  
    //
    LOG_INF("Signal number: %s\n", sig_str); 
    switch (sig)
    {
    case ENTRY_SIG:
        LOG_INF("_fsm_open ENTRY_SIG");
        led_mode(LED_ON);
        break;
    case EXIT_SIG:
        LOG_INF("_fsm_open EXIT_SIG");
        led_mode(LED_OFF);
        break;
    case CARD_SIG:
        LOG_WRN("fsm_open CARD_SIG: Gate is already open.");
        break;
    case PUSH_SIG:
        LOG_WRN("_fsm_open PUSH_SIG: Going through gate.");
        fsm_base_tran(&this->super,(StateFptr)&_fsm_locked);
        break;

    default:
        LOG_ERR("CANT HANDLE DEFUALT");
        break;
    }

}
void _fsm_locked(Fsm *this, const Event * const ev){
    LOG_INF("_fsm_locked begin.");
    Signal sig = ev->sig; 
    char sig_str[20];
    snprintf(sig_str, sizeof(sig_str), "%d", sig);  //
    LOG_INF("Signal number: %s\n", sig_str);
    switch (sig)
    {
    case ENTRY_SIG:
        LOG_INF("_fsm_locked ENTRY_SIG");
        break;
    case EXIT_SIG:
        LOG_INF("_fsm_locked EXIT_SIG");
        break;
    case CARD_SIG:
        LOG_WRN("_fsm_locked CARD_SIG: Key card registrated. Gate is open.");
        fsm_base_tran(&this->super,(StateFptr)&_fsm_open);
        break;
    case PUSH_SIG:
        LOG_WRN("_fsm_locked PUSH_SIG: The gate is locked. Please present card to open gate.");
        break;
    default:
        LOG_ERR("CANT HANDLE DEFUALT");
        break;
    }
   
}

void _fsm_init(Fsm *this, const Event * const ev){
    LOG_INF("_fsm_init begin.");
    Signal sig = ev->sig; 
    switch (sig)
    {
    case INIT_SIG:
        LOG_INF("_fsm_init INIT_SIG");
        led_init();
        fsm_base_tran(&this->super,(StateFptr)&_fsm_locked);
        break;
    case ENTRY_SIG:
        LOG_INF("_fsm_init ENTRY_SIG");
        break;
    case EXIT_SIG:
        LOG_INF("_fsm_init EXIT_SIG");
        break;
    default:
        LOG_ERR("CANT HANDLE DEFUALT");
        break;
    }
}

void fsm_ctr(Fsm *this){
    LOG_INF("fsm_ctr begin.");
    fsm_base_ctr(&this->super,(StateFptr)&_fsm_init);
}
```

## src/fsm.h
```c
#ifndef FSM_H
#define FSM_H
#include <zephyr/kernel.h>
#include "fsm_base.h"

typedef struct Fsm Fsm;
struct Fsm{
    struct FsmBase super;
};

enum{
    CARD_SIG = 2000,
    PUSH_SIG
};

void fsm_ctr(Fsm *this);



#endif
```

## src/fsm_base.c
```c
#include "log.h"
#include "fsm_base.h"

#define FSM_MEM  1024
#define HEAP_MEM 2048

LOG_MODULE_DECLARE(log_module);
K_HEAP_DEFINE(my_heap, HEAP_MEM);

void _fsm_base_dispatch(FsmBase *this, const Event *const ev);
void _fsm_base_event_handler_thread(void *this, void *, void *);

void fsm_base_ctr(FsmBase *this, StateFptr init_state_fptr){
    LOG_INF("fsm_base_ctr begins");
    k_thread_stack_t *ptr = k_heap_alloc(&my_heap,FSM_MEM,K_NO_WAIT);
    // k_thread_stack_t *ev_handler_mem = k_heap_alloc(&fsm_heap, FSM_MEM, K_NO_WAIT);

    LOG_INF("Heap memory allocated");
    this->_heap_mem = ptr;
    if (this->_heap_mem == NULL) {
        LOG_ERR("HEAP FAILED TO ASSIGNE.");
        
    }
    LOG_INF("this got heap mem");
    k_queue_init(&this->_ev_queue);
    LOG_INF("k_queue assigned");
    this->_ev_tid = k_thread_create(&this->_ev_thread_data, this->_heap_mem,
                                        FSM_MEM, _fsm_base_event_handler_thread,
                                        this, NULL, NULL, 1, 0, K_NO_WAIT);
    // this->_ev_tid = k_thread_create(&this->_ev_thread_data,
    //                                 this->_heap_mem,FSM_MEM,
    //                                 _fsm_base_event_handler_thread,
    //                                 this,NULL,NULL, 0,0,K_NO_WAIT);

    this->_state_fptr = init_state_fptr;
    
    Event ev_entry;
    ev_entry.sig = ENTRY_SIG;
    _fsm_base_dispatch(this, &ev_entry);
    
    Event ev_init;
    ev_init.sig = INIT_SIG;
    _fsm_base_dispatch(this, &ev_init);
    LOG_INF("fsm_base_ctr end");
}

void fsm_base_add_ev(FsmBase *this, const Event *const ev){
    LOG_INF("New item added to queue");
    k_queue_append(&this->_ev_queue,(void *)ev);
}

void _fsm_base_dispatch(FsmBase *this,const Event *const ev){
    this->_state_fptr(this, ev);
}
void fsm_base_tran(FsmBase *this, StateFptr new_state_ptr){
    LOG_INF("fsm_base_tran begin");
    Event ev_exit;
    ev_exit.sig = EXIT_SIG;
    _fsm_base_dispatch(this,&ev_exit);

    this->_state_fptr = new_state_ptr;

    Event ev_entry;
    ev_entry.sig = ENTRY_SIG;
    _fsm_base_dispatch(this, &ev_entry);
    LOG_INF("fsm_base_tran end");

}

void _fsm_base_event_handler_thread(void *this,void *,void*){
    LOG_INF("_fsm_base_event_handler_thread started.");
    while(true){
        // FsmBase *this = (FsmBase *) this;// Casting to FsmBase from void *
        // const Event *const ev = (Event *)k_queue_get(&(this)->_ev_queue, K_FOREVER);
        const Event *const ev =
            (Event *)k_queue_get(&((FsmBase *)this)->_ev_queue, K_FOREVER);
        LOG_INF("fsm_base_event_handler_thread got sig");


        // LOG_INF(*(ev)->sig);
        _fsm_base_dispatch(this,ev);
        LOG_INF("_fsm_base_event_handler_thread yielding now.");
        k_yield();
    }
}

void fsm_base_dtr(FsmBase *this){
    k_thread_abort(this->_ev_tid);
    k_heap_free(&my_heap,this->_heap_mem);
}
```

## src/fsm_base.h
```c
#ifndef FSM_BASE_H
#define FSM_BASE_H
#include <zephyr/kernel.h>

typedef struct Event Event;
typedef struct FsmBase FsmBase;
typedef short Signal;


typedef void(*StateFptr)(FsmBase *this, const Event *const ev);


struct FsmBase{
    k_tid_t _ev_tid;
    StateFptr _state_fptr;
    struct k_queue _ev_queue;
    struct k_thread _ev_thread_data;
    k_thread_stack_t *_heap_mem;
};

struct Event{
    Signal sig;
};

enum{
    INIT_SIG=1000,
    ENTRY_SIG,
    EXIT_SIG
};

void fsm_base_ctr(FsmBase *this, StateFptr init_state_fptr);
void fsm_base_dtr(FsmBase *this);
void fsm_base_add_ev(FsmBase *this, const Event *const ev);
void fsm_base_tran(FsmBase *this, StateFptr new_state_ptr);

#endif
```

## src/led.c
```c
#include "led.h"
#include "log.h"
#include <stdio.h>
LOG_MODULE_DECLARE(log_module);


// Device Tree aliases for LEDs
#define LED0_NODE DT_ALIAS(led0)
#define LED1_NODE DT_ALIAS(led1)
#define LED2_NODE DT_ALIAS(led2)
#define LED3_NODE DT_ALIAS(led3)

// GPIO specifications for LEDs
static const struct gpio_dt_spec leds[] = {
    GPIO_DT_SPEC_GET(LED0_NODE, gpios),
    GPIO_DT_SPEC_GET(LED1_NODE, gpios),
    GPIO_DT_SPEC_GET(LED2_NODE, gpios),
    GPIO_DT_SPEC_GET(LED3_NODE, gpios)
};

static const int num_led = ARRAY_SIZE(leds);

void led_init(){
    int ret;
    if (!device_is_ready(leds[0].port)) {
    LOG_ERR("Device is not ready!\n");
    return;
	}

    for (int i = 0; i < num_led; i++){
        ret = gpio_pin_configure_dt(&leds[i], GPIO_OUTPUT_INACTIVE);
        if (ret < 0) {
            return;
        }
    }
    LOG_INF("led_init() complete\n");
}
void led_mode(const short mode){
    
    for (int i = 0; i < num_led; i++){
        gpio_pin_set_dt(&leds[i],mode);
    }
    char modeStr[20];
    snprintf(modeStr, sizeof(modeStr), "%d", mode);  //
    LOG_INF("Led mode: %s\n", modeStr);
}
```

## src/led.h
```c
#ifndef LED_H
#define LED_H

#include <zephyr/drivers/gpio.h>
#include <zephyr/kernel.h>

typedef const enum {
    LED_OFF,
    LED_ON
}led_state;

void led_init();
void led_mode(const short mode);

#endif
```

## src/log.c
```c
#include "log.h"

LOG_MODULE_REGISTER(log_module,LOG_LEVEL_DBG);
```
